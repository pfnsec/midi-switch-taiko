## Kconfig
```
# Copyright (c) 2019 Nordic Semiconductor ASA
# SPDX-License-Identifier: Apache-2.0

source "Kconfig.zephyr"
```

## prj.conf
```kconfig
CONFIG_USB_DEVICE_STACK=y
CONFIG_USB_DEVICE_HID=y
CONFIG_USB_DEVICE_MANUFACTURER="HORI CO.,LTD."
CONFIG_USB_DEVICE_PRODUCT="Taiko Controller"
CONFIG_USB_HID_BOOT_PROTOCOL=y

CONFIG_LOG=y
CONFIG_USB_DRIVER_LOG_LEVEL_ERR=y
CONFIG_USB_DEVICE_LOG_LEVEL_ERR=y

CONFIG_USB_DEVICE_SOF=y
CONFIG_USB_HID_REPORTS=1

CONFIG_USB_DEVICE_VID=0x0F0D
CONFIG_USB_DEVICE_PID=0x00F0

CONFIG_USB_HID_POLL_INTERVAL_MS=2
CONFIG_USB_DEVICE_SN=""
CONFIG_USB_SELF_POWERED=n
CONFIG_USB_MAX_POWER=250

CONFIG_GPIO=y
CONFIG_SERIAL=y
CONFIG_UART_INTERRUPT_DRIVEN=y
```

## boards/nrf52840dk_nrf52840.overlay
```dts
/* SPDX-License-Identifier: Apache-2.0 */
/ {
	aliases {
		midi = &uart1;
	};
};

&uart1 {
  compatible = "nordic,nrf-uarte";
  current-speed = <31250>;
  status = "okay";
  tx-pin = <14>;
  rx-pin = <16>;
};
```

## src/main.c
```c
/*
 * Copyright (c) 2016-2018 Intel Corporation.
 * Copyright (c) 2018-2021 Nordic Semiconductor ASA
 *
 * SPDX-License-Identifier: Apache-2.0
 */

#include <zephyr.h>
#include <init.h>

#include <usb/usb_device.h>
#include <usb/class/usb_hid.h>

#include "buttons.h"
#include "drum.h"
#include "midi.h"

#define LOG_LEVEL LOG_LEVEL_INF
LOG_MODULE_REGISTER(main);

static bool configured;
static const struct device *hdev;
static struct k_work report_send;
static ATOMIC_DEFINE(hid_ep_in_busy, 1);

#define HID_EP_BUSY_FLAG	0
#define REPORT_ID_1		0x01
#define REPORT_PERIOD		K_MSEC(5)

static struct report {
	uint8_t id;
	uint8_t value;
} __packed report_1 = {
	.id = REPORT_ID_1,
	.value = 0,
};

static drum_state drum_state_1 = {
	.state_0 = 0,
	.state_1 = 0,
	.state_2 = 0,
	.state_3 = 0,
	.state_4 = 0,
	.state_5 = 0,
	.state_6 = 0,
	.state_7 = 0,
};


static void report_event_handler(struct k_timer *dummy);
static K_TIMER_DEFINE(event_timer, report_event_handler, NULL);

/*
 * Simple HID Report Descriptor
 * Report ID is present for completeness, although it can be omitted.
 * Output of "usbhid-dump -d 2fe3:0006 -e descriptor":
 *  05 01 09 00 A1 01 15 00    26 FF 00 85 01 75 08 95
 *  01 09 00 81 02 C0
 */
static const uint8_t hid_in_report_desc[] = {
	HID_USAGE_PAGE(HID_USAGE_GEN_DESKTOP),
	HID_USAGE(HID_USAGE_GEN_DESKTOP_GAMEPAD),
	HID_COLLECTION(HID_COLLECTION_APPLICATION),
	HID_LOGICAL_MIN8(0x00),
	HID_LOGICAL_MAX16(0xFF, 0x00),
	//HID_REPORT_ID(REPORT_ID_1),
	HID_REPORT_SIZE(64),
	HID_REPORT_COUNT(1),
	HID_USAGE(HID_USAGE_GEN_DESKTOP_GAMEPAD),
	HID_INPUT(0x02),
	HID_END_COLLECTION,
};

static const uint8_t hid_out_report_desc[] = {
	HID_USAGE_PAGE(HID_USAGE_GEN_DESKTOP),
	HID_USAGE(HID_USAGE_GEN_DESKTOP_GAMEPAD),
	HID_COLLECTION(HID_COLLECTION_APPLICATION),
	HID_LOGICAL_MIN8(0x00),
	HID_LOGICAL_MAX16(0xFF, 0x00),
	//HID_REPORT_ID(REPORT_ID_1),
	HID_REPORT_SIZE(64),
	HID_REPORT_COUNT(1),
	HID_USAGE(HID_USAGE_GEN_DESKTOP_GAMEPAD),
	HID_OUTPUT(0x81),
	HID_END_COLLECTION,
};

static void send_report(struct k_work *work)
{
	int ret, wrote;

	if (!atomic_test_and_set_bit(hid_ep_in_busy, HID_EP_BUSY_FLAG)) {
		ret = hid_int_ep_write(hdev, (uint8_t *)&drum_state_1,
				       sizeof(drum_state), &wrote);
		if (ret != 0) {
			/*
			 * Do nothing and wait until host has reset the device
			 * and hid_ep_in_busy is cleared.
			 */
			LOG_ERR("Failed to submit report");
		} else {
			LOG_DBG("Report submitted");
		}
	} else {
		LOG_DBG("HID IN endpoint busy");
	}
}

static void int_in_ready_cb(const struct device *dev)
{
	ARG_UNUSED(dev);
	if (!atomic_test_and_clear_bit(hid_ep_in_busy, HID_EP_BUSY_FLAG)) {
		LOG_WRN("IN endpoint callback without preceding buffer write");
	}
}

/*
 * On Idle callback is available here as an example even if actual use is
 * very limited. In contrast to report_event_handler(),
 * report value is not incremented here.
 */
static void on_idle_cb(const struct device *dev, uint16_t report_id)
{
	LOG_DBG("On idle callback");
	//k_work_submit(&report_send);
}

static void report_event_handler(struct k_timer *dummy)
{
	/* Increment reported data */
	report_1.value++;
	read_buttons(&drum_state_1);
	k_work_submit(&report_send);
}

static void protocol_cb(const struct device *dev, uint8_t protocol)
{
	LOG_INF("New protocol: %s", protocol == HID_PROTOCOL_BOOT ?
		"boot" : "report");
}

static const struct hid_ops ops = {
	.int_in_ready = int_in_ready_cb,
	.on_idle = on_idle_cb,
	.protocol_change = protocol_cb,
};

static void status_cb(enum usb_dc_status_code status, const uint8_t *param)
{
	switch (status) {
	case USB_DC_RESET:
		configured = false;
		break;
	case USB_DC_CONFIGURED:
		if (!configured) {
			int_in_ready_cb(hdev);
			configured = true;
		}
		break;
	case USB_DC_SOF:
		break;
	default:
		LOG_DBG("status %u unhandled", status);
		break;
	}
}

void main(void)
{
	int ret;

	LOG_INF("Starting application");

	buttons_init();
	midi_init();

	ret = usb_enable(status_cb);
	if (ret != 0) {
		LOG_ERR("Failed to enable USB");
		return;
	}

	k_work_init(&report_send, send_report);
}

static int composite_pre_init(const struct device *dev)
{
	hdev = device_get_binding("HID_0");
	if (hdev == NULL) {
		LOG_ERR("Cannot get USB HID Device");
		return -ENODEV;
	}

	LOG_INF("HID Device: dev %p", hdev);

	usb_hid_register_device(hdev, hid_in_report_desc, sizeof(hid_in_report_desc),
				&ops);
				
	//usb_hid_register_device(hdev, hid_out_report_desc, sizeof(hid_out_report_desc),
	//			&ops);

	atomic_set_bit(hid_ep_in_busy, HID_EP_BUSY_FLAG);
	k_timer_start(&event_timer, REPORT_PERIOD, REPORT_PERIOD);

	if (usb_hid_set_proto_code(hdev, HID_BOOT_IFACE_CODE_NONE)) {
		LOG_WRN("Failed to set Protocol Code");
	}

	return usb_hid_init(hdev);
}

SYS_INIT(composite_pre_init, APPLICATION, CONFIG_KERNEL_INIT_PRIORITY_DEVICE);
```

## src/buttons.c
```c
#include <zephyr.h>
#include <device.h>
#include <drivers/gpio.h>
#include <sys/util.h>
#include <sys/printk.h>
#include <inttypes.h>

#include "buttons.h"
#include "midi.h"
#include "notes.h"


static const struct gpio_dt_spec button = GPIO_DT_SPEC_GET_OR(SW0_NODE, gpios,
							      {0});
static struct gpio_callback button_cb_data;


void button_pressed(const struct device *dev, struct gpio_callback *cb,
		    uint32_t pins)
{
	printk("Button pressed at %" PRIu32 "\n", k_cycle_get_32());
}

void buttons_init() {

	int ret;

	if (!device_is_ready(button.port)) {
		printk("Error: button device %s is not ready\n",
		       button.port->name);
		return;
	}

	ret = gpio_pin_configure_dt(&button, GPIO_INPUT);
	if (ret != 0) {
		printk("Error %d: failed to configure %s pin %d\n",
		       ret, button.port->name, button.pin);
		return;
	}

	ret = gpio_pin_interrupt_configure_dt(&button,
					      GPIO_INT_EDGE_TO_ACTIVE);
	if (ret != 0) {
		printk("Error %d: failed to configure interrupt on %s pin %d\n",
			ret, button.port->name, button.pin);
		return;
	}

	gpio_init_callback(&button_cb_data, button_pressed, BIT(button.pin));
	gpio_add_callback(button.port, &button_cb_data);
	printk("Set up button at %s pin %d\n", button.port->name, button.pin);
}


#define DRUM_COOLDOWN 10


static uint8_t drum_cooldown[8];

void update_cooldown(uint8_t note) {

    switch(note) {
        case SNARE:
            drum_cooldown[SNARE_I] = DRUM_COOLDOWN;
            break;
        case HI_TOM:
            drum_cooldown[HI_TOM_I] = DRUM_COOLDOWN;
            break;
        case MID_TOM:
            drum_cooldown[MID_TOM_I] = DRUM_COOLDOWN;
            break;
        case LOW_TOM:
            drum_cooldown[LOW_TOM_I] = DRUM_COOLDOWN;
            break;
        case CRASH:
            drum_cooldown[CRASH_I] = DRUM_COOLDOWN;
            break;
        case RIDE:
            drum_cooldown[RIDE_I] = DRUM_COOLDOWN;
            break;
        case HI_HAT:
            drum_cooldown[HI_HAT_I] = DRUM_COOLDOWN;
            break;
        default:
            break;
    }
}

void read_buttons(drum_state *state) {
    midi_message *msg;
    msg = midi_read();

    state->state_0 = 0;
    state->state_1 = 0;
    state->state_2 = 15;
    state->state_3 = 128;
    state->state_4 = 128;
    state->state_5 = 128;
    state->state_6 = 128;
    state->state_7 = 0;

    if(msg != NULL) {
        //printk("NOTE %d, VEL %d\n", msg->note, msg->velocity);
        if(msg->velocity > 0) {
            update_cooldown(msg->note);
        }
        midi_free(msg);
    }

    if(drum_cooldown[SNARE_I] > 0) {
        state->state_1 |= 4;
    }

    if(drum_cooldown[HI_TOM_I] > 0) {
        state->state_0 |= 64;
    }

    if(drum_cooldown[MID_TOM_I] > 0) {
        state->state_0 |= 128;
    }

    if(drum_cooldown[LOW_TOM_I] > 0) {
        state->state_1 |= 8;
    }

    if(drum_cooldown[CRASH_I] > 0) {
        state->state_0 |= 4;
    }

    if(drum_cooldown[RIDE_I] > 0) {
        state->state_0 |= 48;
    }

    if(drum_cooldown[HI_HAT_I] > 0) {
        state->state_1 |= 2;
    }

    for(int i = 0; i <= DRUM_I_MAX; i++) {
        if(drum_cooldown[i] > 0) {
            drum_cooldown[i]--;
        }
    }
}
```

## src/buttons.h
```c
#ifndef BUTTONS_H
#define BUTTONS_H

#include <zephyr.h>
#include <device.h>
#include "drum.h"

#define SW0_NODE	DT_ALIAS(sw0)
#define SW1_NODE	DT_ALIAS(sw1)
#define SW2_NODE	DT_ALIAS(sw2)
#define SW3_NODE	DT_ALIAS(sw3)

#if !DT_NODE_HAS_STATUS(SW0_NODE, okay)
#error "Unsupported board: sw0 devicetree alias is not defined"
#endif

#if !DT_NODE_HAS_STATUS(SW1_NODE, okay)
#error "Unsupported board: sw1 devicetree alias is not defined"
#endif

#if !DT_NODE_HAS_STATUS(SW2_NODE, okay)
#error "Unsupported board: sw2 devicetree alias is not defined"
#endif

#if !DT_NODE_HAS_STATUS(SW3_NODE, okay)
#error "Unsupported board: sw3 devicetree alias is not defined"
#endif

void buttons_init();

void read_buttons(drum_state *state);

#endif
```

## src/drum.h
```c
#ifndef DRUM_H
#define DRUM_H

#include <stdint.h>


typedef struct drum_state {
    uint8_t state_0;
    uint8_t state_1;
    uint8_t state_2;
    uint8_t state_3;
    uint8_t state_4;
    uint8_t state_5;
    uint8_t state_6;
    uint8_t state_7;
} __packed drum_state;


#endif
```

## src/midi.c
```c
#include <zephyr.h>
#include <arch/cpu.h>
#include <sys/byteorder.h>
#include <logging/log.h>
#include <sys/util.h>

#include <device.h>
#include <init.h>
#include <drivers/uart.h>

#include "midi.h"

static K_FIFO_DEFINE(midi_fifo);
static K_MEM_SLAB_DEFINE(midi_slab, sizeof(midi_message), 64, 4);


static struct device *midi_uart_dev;

static midi_message *latest_message = NULL;
static uint8_t state = MIDI_STATE_IDLE;

static void midi_uart_isr(const struct device *unused, void *user_data) {
	ARG_UNUSED(unused);
	ARG_UNUSED(user_data);

    if(latest_message == NULL) {
        k_mem_slab_alloc(&midi_slab, &latest_message, K_FOREVER);
        //printk("Realloc message... %p\n", latest_message);
    }

	if (!(uart_irq_rx_ready(midi_uart_dev) ||
	      uart_irq_tx_ready(midi_uart_dev))) {
		printk("spurious interrupt");
	}

	if (uart_irq_tx_ready(midi_uart_dev)) {
		printk("tx_ready");
	}

	if (uart_irq_rx_ready(midi_uart_dev)) {
		//printk("rx_ready");
        static uint8_t chr; 

        int rx = uart_fifo_read(midi_uart_dev, &chr, sizeof(chr));
        if(!rx) {
            return;
        }

        static uint8_t running_status;
        switch(state) {
        case MIDI_STATE_IDLE:
            if(MIDI_IS_STATUS(chr)){
                if(MIDI_STATUS(chr) == MIDI_NOTE_ON) {
                    state = MIDI_STATE_NOTE1;
                    running_status = chr;
                } else if(MIDI_STATUS(chr) == 0xF) {
                    // sysex, don't update running_status
                } else {
                    running_status = chr;
                }
            } else {
                if(MIDI_STATUS(running_status) == MIDI_NOTE_ON) {
                    latest_message->note = chr;
                    state = MIDI_STATE_NOTE2;
                }
                //printk("DATA in IDLE! %x\n", chr);
            }
            
            break;
        case MIDI_STATE_NOTE1:
            if(MIDI_IS_DATA(chr)){
                latest_message->note = chr;
                state = MIDI_STATE_NOTE2;
            } else {
                printk("STATUS in NOTE1! \n");
            }
            break;
        case MIDI_STATE_NOTE2:
            if(MIDI_IS_DATA(chr)){
                latest_message->velocity = chr;
                k_fifo_put(&midi_fifo, latest_message);
                k_mem_slab_alloc(&midi_slab, &latest_message, K_FOREVER);
                state = MIDI_STATE_IDLE;
            } else {
                printk("STATUS in NOTE2! \n");
            }
            break;
        default:
            printk("STATE CORRUPTED! \n");
            break;
        }
	}
}

int midi_init() {

    midi_uart_dev = device_get_binding(DT_LABEL(DT_NODELABEL(uart1)));
	if (midi_uart_dev == NULL) {
        printk("midi dev null!");
		return -1;
	}

	if (!device_is_ready(midi_uart_dev)) {
		printk("MIDI UART %s is not ready", midi_uart_dev->name);
		return -EINVAL;
	}

	uart_irq_rx_disable(midi_uart_dev);
	uart_irq_tx_disable(midi_uart_dev);

	uart_irq_callback_set(midi_uart_dev, midi_uart_isr);

	uart_irq_rx_enable(midi_uart_dev);

	return 0;
}

midi_message *midi_read() {
    return k_fifo_get(&midi_fifo, K_NO_WAIT);
}

void midi_free(midi_message *message) {
    k_mem_slab_free(&midi_slab, &message);
}
```

## src/midi.h
```c
#ifndef MIDI_H
#define MIDI_H

#include <zephyr.h>

#define MIDI_IS_STATUS(x)  (x & (1 << 7))
#define MIDI_IS_DATA(x)   !(x & (1 << 7))
#define MIDI_STATUS(x)    ((x & 0xF0) >> 4)
#define MIDI_INFO(x)       (x & 0x0F)
#define MIDI_STATUS(x)    ((x & 0xF0) >> 4)
#define MIDI_INFO(x)       (x & 0x0F)
#define MIDI_NOTE_ON        0x9
#define MIDI_NOTE_OFF       0x8

#define MIDI_STATE_IDLE     0x0
#define MIDI_STATE_NOTE1    0x1
#define MIDI_STATE_NOTE2    0x2

int midi_init();

typedef struct midi_message {
    void *fifo_reserved;
    uint8_t note;
    uint8_t velocity;
} midi_message;

midi_message *midi_read();
void midi_free(midi_message *message);

#endif
```

## src/notes.h
```c
#ifndef NOTES_H
#define NOTES_H

#define SNARE   31
#define HI_TOM  48
#define MID_TOM 47
#define LOW_TOM 43
#define CRASH   49
#define RIDE    51
#define HI_HAT  46

#define SNARE_I   0
#define HI_TOM_I  1
#define MID_TOM_I 2
#define LOW_TOM_I 3
#define CRASH_I   4
#define RIDE_I    5
#define HI_HAT_I  6

#define DRUM_I_MAX 6

#endif
```
